## arch/arm/mach-emxx/Kconfig
```kconfig
if ARCH_EMXX

menu "EMMA Mobile series Implementations"

choice
	prompt "EMMA Mobile Core Type"
	default MACH_EMEV

config MACH_EMEV
	bool "EMMA Mobile EV1/EV2"
	select CPU_V7

config MACH_EMGR
	bool "EMMA Mobile EV0"
	select CPU_V7
endchoice

choice
	prompt "EMMA Mobile Board Type"
	default EMEV_BOARD_EVA

config EMEV_BOARD_EVA
	bool "EMMA Mobile EV1/2 Evaluation board"
	depends on MACH_EMEV

config EMGR_BOARD_EVA
	bool "EMMA Mobile EV0 Evaluation board"
	depends on MACH_EMGR
endchoice

if MACH_EMGR
choice
	prompt "EMMA Mobile EV0 Memory size"
	default EMGR_2G_MEM

config EMGR_2G_MEM
	bool "2G Bit"

config EMGR_1G_MEM
	bool "1G Bit"
endchoice
endif

config EMGR_TI_PMIC
	bool "TI power board support"
	depends on EMGR_BOARD_EVA

config EMXX_QR
	bool "Enable QR"
	default y

config EMXX_L310
	bool "ARM L2 cache Enable"
	default y
	select CACHE_L2X0
	select EMXX_L310_NORAM if MACH_EMGR

config EMXX_L310_NORAM
	bool
	depends on MACH_EMGR

if MACH_EMEV

config EMXX_L310_WT
	bool "ARM L2 cache WriteThrough"
	depends on EMXX_L310
	default n

choice
	prompt "L2 cache way-size"
	depends on EMXX_L310
	default EMXX_L310_8WAY

config EMXX_L310_8WAY
	bool "8way 32KByte"

config EMXX_L310_16WAY
	bool "16way 16KByte"
endchoice

config PL310_ERRATA_727915
	bool "PL310 errata: Background Clean & Invalidate by Way operation can cause data"
	default y
	help
	  This option enables the workaround for the 727915 PL310 L2 cache
	  controller (r2p0,r3p0) erratum. PL310 implements the Clean &
	  Invalidate by Way L2 cache maintenance operation (offset 0x7FC).
	  This operation runs in background so that PL310 can handle normal
	  accesses while it is in progress. Under very rare circumstances, due
	  to this erratum, write data can be lost when PL310 treats a cacheable
	  write transaction during a Clean & Invalidate by Way operation.
endif

choice
	prompt "Target board System clock(PLL3)"
	default EMXX_PLL3_230MHZ

config EMXX_PLL3_230MHZ
	bool "230MHZ"

config EMXX_PLL3_238MHZ
	bool "238MHZ"
endchoice

config EMXX_ANDROID
	bool "Use Android setting"

config EMXX_SPI0
	bool "SPI0 Driver support"
	default y

config EMXX_SPI_EXCL_SP0
	int "SP0 Exclusive control method (0:scheduling/1:interrupt disabled)"
	depends on EMXX_SPI0
	default "1"

config EMXX_SPI
	tristate "SPI Driver support (SPI1)"

config EMXX_PWM
	tristate "PWM Driver support"

config EMXX_DTV
	tristate "DTV Interface support"

config EMXX_DTV_BUFFERSIZE
	int "DMA buffer size (752-)[byte]"
	depends on EMXX_DTV
	default "8192"

config EMXX_PWC
	bool
	depends on EMXX_SPI0
	default y

config EMXX_EXTIO
	bool
	depends on (EMEV_BOARD_EVA || EMGR_BOARD_EVA) && I2C
	default y

config EMXX_LED
	bool
	depends on EMXX_PWC
	default y

config EMXX_PDMA
	tristate "Software interrupt support for PDMA"
	depends on MACH_EMGR
	default y

config EMXX_INTERDSP
	tristate "InterDSP support"
	default m

config ARM_ERRATA_716044
	bool "ARM errata: Under very rare circumstances, an uncacheable load multiple instruction can cause a deadlock"
	depends on CPU_V7
	default y if MACH_EMEV
	help
	  This option enables the workaround for the 716044 Cortex-A9
	  (r1p0..r1p2) erratum. Under some rare circumstances, an uncacheable
	  load multiple instruction (LDRD, LDM, VLDM, VLD1, VLD2, VLD3, VLD4)
	  can cause a processor deadlock.

config ARM_ERRATA_720789
	bool "ARM errata: TLBIASIDIS and TLBIMVAIS operations can broadcast a faulty ASID"
	depends on CPU_V7 && SMP
	default y
	help
	  This option enables the workaround for the 720789 Cortex-A9 (prior to
	  r2p0) erratum. A faulty ASID can be sent to the other CPUs for the
	  broadcasted CP15 TLB maintenance operations TLBIASIDIS and TLBIMVAIS.
	  As a consequence of this erratum, some TLB entries which should be
	  invalidated are not, resulting in an incoherency in the system page
	  tables. The workaround changes the TLB flushing routines to invalidate
	  entries regardless of the ASID.

config ARM_ERRATA_742230
	bool "ARM errata: DMB behaviour may be faulty"
	depends on CPU_V7
	default y
	help
		Cortex-A9 MPCore (r1p0..r2p2) erratum

config ARM_ERRATA_743622
	bool "ARM errata: Faulty hazard checking in the Store Buffer may lead to data corruption"
	depends on MACH_EMGR
	default y
	help
	  This option enables the workaround for the 743622 Cortex-A9
	  (r2p0..r2p8) erratum. Under very rare conditions, a faulty optimization
	  in the Cortex-A9 Store Buffer may lead to data corruption.

config ARM_ERRATA_751472
	bool "An interrupted ICIALLUIS operation may prevent the completion of a following broadcasted operation"
	depends on CPU_V7 && SMP
	default y
	help
	  This option enables the workaround for the 751472 Cortex-A9 MPCore(prior to
	  r3p0) erratum. In an MPCore configuration with 2 processors or more working
	  in SMP mode with maintenance operation broadcast enabled, if a processor is
	  interrupted while executing an ICIALLUIS operation, and performs another
	  broadcasted maintenance operation during its Interrupt Service Routine,
	  then this second operation may not be executed on the other processors in the cluster.

if MACH_EMEV
config EMXX_DMA_LCH0
	int "P2M/M2P DMA LCH0 device"
	default 7
	help
	   0:MMM    1:MSP_GDF  2:MSP_PB  3:CRP
	   6:UART0  7:UART1    8:UART2   9:UART3 10:SIO0  11:SIO1
	   12:SIO2 13:SIO3    14:SIO4   15:SIO5

config EMXX_DMA_LCH1
	int "P2M/M2P DMA LCH1 device"
	default 0
	help
	   0:MMM    1:MSP_GDF  2:MSP_PB  3:CRP
	   6:UART0  7:UART1    8:UART2   9:UART3 10:SIO0  11:SIO1
	   12:SIO2 13:SIO3    14:SIO4   15:SIO5

config EMXX_DMA_LCH2
	int "P2M/M2P DMA LCH2 device"
	default 1
	help
	   0:MMM    1:MSP_GDF  2:MSP_PB  3:CRP 
	   6:UART0  7:UART1    8:UART2   9:UART3 10:SIO0  11:SIO1
	   12:SIO2 13:SIO3    14:SIO4   15:SIO5

config EMXX_DMA_LCH3
	int "P2M/M2P DMA LCH3 device"
	default 2
	help
	   0:MMM    1:MSP_GDF  2:MSP_PB  3:CRP
	   6:UART0  7:UART1    8:UART2   9:UART3 10:SIO0  11:SIO1
	   12:SIO2 13:SIO3    14:SIO4   15:SIO5

config EMXX_DMA_LCH4
	int "P2M/M2P DMA LCH4 device"
	default 10
	help
	   0:MMM    1:MSP_GDF  2:MSP_PB  3:CRP
	   6:UART0  7:UART1    8:UART2   9:UART3 10:SIO0  11:SIO1
	   12:SIO2 13:SIO3    14:SIO4   15:SIO5

config EMXX_DMA_LCH5
	int "P2M/M2P DMA LCH5 device"
	default 11
	help
	   0:MMM    1:MSP_GDF  2:MSP_PB  3:CRP
	   6:UART0  7:UART1    8:UART2   9:UART3 10:SIO0  11:SIO1
	   12:SIO2 13:SIO3    14:SIO4   15:SIO5

config EMXX_DMA_LCH6
	int "P2M/M2P DMA LCH6 device"
	default 12
	help
	   0:MMM    1:MSP_GDF  2:MSP_PB  3:CRP
	   6:UART0  7:UART1    8:UART2   9:UART3 10:SIO0  11:SIO1
	   12:SIO2 13:SIO3    14:SIO4   15:SIO5

config EMXX_DMA_LCH7
	int "P2M/M2P DMA LCH7 device"
	default 13
	help
	   0:MMM    1:MSP_GDF  2:MSP_PB  3:CRP
	   6:UART0  7:UART1    8:UART2   9:UART3 10:SIO0  11:SIO1
	   12:SIO2 13:SIO3    14:SIO4   15:SIO5
endif

if MACH_EMGR
config EMXX_DMA_LCH0
	int "P2M/M2P DMA LCH0 device"
	default 7
	help
	   0:MMM    1:MSP_GDF  2:MSP_PB  4:UART4  5:UART5
	   6:UART0  7:UART1    8:UART2   9:UART3 10:SIO0  11:SIO1
	   12:SIO2 13:SIO3

config EMXX_DMA_LCH1
	int "P2M/M2P DMA LCH1 device"
	default 0
	help
	   0:MMM    1:MSP_GDF  2:MSP_PB  4:UART4  5:UART5
	   6:UART0  7:UART1    8:UART2   9:UART3 10:SIO0  11:SIO1
	   12:SIO2 13:SIO3

config EMXX_DMA_LCH2
	int "P2M/M2P DMA LCH2 device"
	default 1
	help
	   0:MMM    1:MSP_GDF  2:MSP_PB  4:UART4  5:UART5
	   6:UART0  7:UART1    8:UART2   9:UART3 10:SIO0  11:SIO1
	   12:SIO2 13:SIO3

config EMXX_DMA_LCH3
	int "P2M/M2P DMA LCH3 device"
	default 2
	help
	   0:MMM    1:MSP_GDF  2:MSP_PB  4:UART4  5:UART5
	   6:UART0  7:UART1    8:UART2   9:UART3 10:SIO0  11:SIO1
	   12:SIO2 13:SIO3

config EMXX_DMA_LCH4
	int "P2M/M2P DMA LCH4 device"
	default 10
	help
	   0:MMM    1:MSP_GDF  2:MSP_PB  4:UART4  5:UART5
	   6:UART0  7:UART1    8:UART2   9:UART3 10:SIO0  11:SIO1
	   12:SIO2 13:SIO3

config EMXX_DMA_LCH5
	int "P2M/M2P DMA LCH5 device"
	default 11
	help
	   0:MMM    1:MSP_GDF  2:MSP_PB  4:UART4  5:UART5
	   6:UART0  7:UART1    8:UART2   9:UART3 10:SIO0  11:SIO1
	   12:SIO2 13:SIO3

config EMXX_DMA_LCH6
	int "P2M/M2P DMA LCH6 device"
	default 12
	help
	   0:MMM    1:MSP_GDF  2:MSP_PB  4:UART4  5:UART5
	   6:UART0  7:UART1    8:UART2   9:UART3 10:SIO0  11:SIO1
	   12:SIO2 13:SIO3

config EMXX_DMA_LCH7
	int "P2M/M2P DMA LCH7 device"
	default 13
	help
	   0:MMM    1:MSP_GDF  2:MSP_PB  4:UART4  5:UART5
	   6:UART0  7:UART1    8:UART2   9:UART3 10:SIO0  11:SIO1
	   12:SIO2 13:SIO3
endif

endmenu

endif
```

## drivers/ave/Kconfig
```kconfig
#
# AVE dricer configuration
#

menu "EMMA Mobile series AVE support"
        depends on ARCH_EMXX

config EMXX_AVE
	tristate "EMXX AVE support"
	default m
	help
          This is the AVE device driver for EMMA Mobile series boards.

config EMXX_AVE_VC1
       bool "AVE VC-1 support"
       depends on EMXX_AVE
       default y
       help
         AVE device driver support VC-1 decode.

endmenu
```

## drivers/imc/Kconfig
```kconfig
#
# IMC driver configuration
#

menu "EMXX IMC support"
        depends on ARCH_EMXX

config EMXX_IMC
	bool "EMXX IMC support"
	default y
	help
          This is the IMC device driver for EMXX boards.

endmenu
```

## drivers/media/video/emxx/Kconfig
```kconfig
config VIDEO_EMXX
	bool "EMXX Video for Linux2 driver"
	depends on VIDEO_DEV && ARCH_EMXX && EMXX_SIZROT2
	default y
	select VIDEO_BUF

config VIDEO_EMXX_FRAMESKIP
	bool "enable frame skip function"
	depends on VIDEO_EMXX
	default y

config VIDEO_EMXX_FILTER
	bool "enable setting resize filter function"
	depends on VIDEO_EMXX
	default y

config VIDEO_EMXX_IMAGESIZE
	bool "enable to set original image size"
	depends on VIDEO_EMXX
	default y
```

## drivers/media/video/emxx_cam/Kconfig
```kconfig
config VIDEO_EMXX_CAMERA
	tristate "EMXX Video for Linux2 camera driver"
	depends on VIDEO_DEV && MACH_EMEV

choice
	prompt "Camera Device"
	depends on VIDEO_EMXX_CAMERA

config VIDEO_EMXX_CAMERA_RJ6ABA100
	boolean "RJ6ABA100"

config EMXX_CAMERA_RJ6ABA100
	tristate
	depends on VIDEO_EMXX_CAMERA_RJ6ABA100
	default VIDEO_EMXX_CAMERA

endchoice
```

## drivers/nts/Kconfig
```kconfig
#
# NTS driver configuration
#

menu "EMXX Video-out support"
        depends on FB_EMXX

config EMXX_NTS
	bool "EMXX NTSC Video-out support"
        depends on VIDEO_EMXX
	default y
        help
          This is the TV out subsystem for EMXX seriase boards.

choice
	prompt "NTS Video Encoder Device"
	depends on EMXX_NTS

config EMXX_NTS_ADV7179
	bool "ADV7179"
endchoice

choice
	bool "ADV7179 Video-Encoder option"
        depends on EMXX_NTS_ADV7179
	default EMXX_NTS_PAL

config EMXX_NTS_PAL
	bool "PAL B/D/G/H/I/N"
        help
          Selected this configuration is support PAL B/D/G/H/I/N.

config EMXX_NTS_PAL60
	bool "PAL-60"
        help
          Selected this configuration is support PAL-60.
endchoice

endmenu
```

## drivers/sizrot2/Kconfig
```kconfig
#
# SIZ/ROT driver configuration
#

menu "EMXX SIZ/ROT support"
        depends on ARCH_EMXX

config EMXX_SIZROT2
	bool "EMXX SIZ/ROT support"
	default y
	help
          This is the SIZ/ROT device driver for EMXX boards.

endmenu
```

## drivers/video/emxx/Kconfig
```kconfig
#
# EMXX fb driver configuration
#

menu "EMXX Video subsystem"
        depends on FB && ARCH_EMXX

config EMXX_VIDEO
	bool "EMXX Video subsystem"
        depends on FB && ARCH_EMXX
	default y
        help
          This is the Video subsystem for EMXX seriase boards.

config FB_EMXX
	bool "EMXX FB support"
        depends on EMXX_VIDEO
	default y
	select FB_CFB_FILLRECT
	select FB_CFB_COPYAREA
	select FB_CFB_IMAGEBLIT
        help
          This is the frame buffer device driver for EMXX seriase boards.

config FB_EMXX_ARGB8888
        bool "EMXX FB ARGB8888 framebuffer support"
        depends on FB_EMXX
        default n
        help
          Support ARGB8888 framebuffer for EMXX seriase boards.

config FB_EMXX_ABGR8888
        bool "EMXX FB ABGR8888 framebuffer support"
        depends on FB_EMXX_ARGB8888
        default n
        help
          Support ABGR8888 framebuffer for EMXX seriase boards.

config FB_EMXX_BGR888
        bool "EMXX FB BGR888 framebuffer support"
        depends on FB_EMXX
        default n

config EMXX_LCD_FRAMECACHE
        bool "EMXX LCD FRAMECACHE support"
        depends on FB_EMXX
        default y
        help
          Support LCD framecache for EMXX seriase boards.

config FB_EMXX_PANDISP
	bool "EMXX fb_pan_display support"
        depends on FB_EMXX
	default y
        help
          Support fb_pan_display for EMXX seriase boards.

config FB_EMXX_PANDISP_BLOCK
	bool "EMXX fb_pan_display BLOCK support"
        depends on FB_EMXX_PANDISP
	default y
        help
          fb_pan_display returns after flip is completed.

config FB_EMXX_COPYBIT_PREMULTI
        bool "EMXX Copybit Premultiplied alpha support"
        depends on FB_EMXX && EMXX_ANDROID
        default y

config EMXX_HDMI
	bool "EMXX HDMI support"
        depends on EMXX_VIDEO
	default n
        help
          This is the HDMI device driver for EMXX seriase boards.

config EMXX_HDMI_ADV7523
	tristate "EMXX HDMI ADV7523 support"
        depends on EMXX_HDMI
	default y
        help
          Support ADV7523 HDMI TX for EMXX seriase boards.

config EMXX_HDMI_ADV7523_DEBUG
	bool "EMXX HDMI ADV7523 debug message"
        depends on EMXX_HDMI_ADV7523 && DEBUG_KERNEL
	default n
        help
          Debug message from ADV7523 HDMI TX driver.


endmenu
```

## fs/cramfs/Kconfig
```kconfig
config CRAMFS
	tristate "Compressed ROM file system support (cramfs)"
	depends on BLOCK
	select ZLIB_INFLATE
	help
	  Saying Y here includes support for CramFs (Compressed ROM File
	  System).  CramFs is designed to be a simple, small, and compressed
	  file system for ROM based embedded systems.  CramFs is read-only,
	  limited to 256MB file systems (with 16MB files), and doesn't support
	  16/32 bits uid/gid, hard links and timestamps.

	  See <file:Documentation/filesystems/cramfs.txt> and
	  <file:fs/cramfs/README> for further information.

	  To compile this as a module, choose M here: the module will be called
	  cramfs.  Note that the root file system (the one containing the
	  directory /) cannot be compiled as a module.

	  If unsure, say N.

config CRAMFS_LINEAR
	bool "Use linear addressing for CramFs"
	depends on CRAMFS
	help
	  This option tells the CramFs driver to load data directly from
	  a linear adressed memory range (usually non volatile memory
	  like flash) instead of going through the block device layer.
	  This saves some memory since no intermediate buffering is
	  necessary.

	  This is also a prerequisite for XIP of binaries stored on the
	  filesystem.

	  The location of the CramFs image in memory is board
	  dependent. Therefore, if you say Y, you must know the proper
	  physical address where to store the CramFs image and specify
	  it using the physaddr=0x******** mount option (for example:
	  "mount -t cramfs -o physaddr=0x100000 none /mnt").

	  If unsure, say N.

config ROOT_CRAMFS_LINEAR
	bool "Root file system on linear CramFs"
	depends on CRAMFS_LINEAR
	help
	  Say Y if you have enabled linear CramFs, and you want to be
	  able to use the linear CramFs image as a root file system.  To
	  actually have the kernel mount this CramFs image as a root
	  file system, you must also pass the command line parameter
	  "root=/dev/null rootflags=physaddr=0x********" to the kernel
	  (replace 0x******** with the physical address location of the
	  linear CramFs image to boot with).
```
